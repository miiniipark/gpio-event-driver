## yocto/meta-gpio-event/conf/layer.conf
```bitbake
BBPATH .= ":${LAYERDIR}"

BBFILES += "${LAYERDIR}/recipes-*/*/*.bb \
            ${LAYERDIR}/recipes-*/*/*.bbappend"

BBFILE_COLLECTIONS += "gpio-event"
BBFILE_PATTERN_gpio-event = "^${LAYERDIR}/"
BBFILE_PRIORITY_gpio-event = "6"

LAYERSERIES_COMPAT_gpio-event = "scarthgap"
```
